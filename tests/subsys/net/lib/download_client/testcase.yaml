## tests/subsys/net/lib/download_client/testcase.yaml
```yaml
tests:
  net.lib.download_client:
    tags: aws fota
    platform_allow: nrf9160dk_nrf9160 nrf9160dk_nrf9160_ns
    integration_platforms:
      - nrf9160dk_nrf9160
      - nrf9160dk_nrf9160_ns
```

## tests/subsys/net/lib/lwm2m_client_utils/lwm2m/lwm2m_firmware/testcase.yaml
```yaml
tests:
  net.lwm2m_client_utils.lwm2m.lwm2m_firmware:
    tags: fota
    platform_allow: native_posix nrf9160dk_nrf9160 nrf9160dk_nrf9160_ns
    integration_platforms:
      - native_posix
      - nrf9160dk_nrf9160
      - nrf9160dk_nrf9160_ns
```
